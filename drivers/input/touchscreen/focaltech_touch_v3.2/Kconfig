## drivers/input/touchscreen/focaltech_touch_v3.2/Kconfig
```kconfig
#
# Focaltech Touchscreen driver configuration
#

config TOUCHSCREEN_FTS_V32
    bool "Focaltech Touchscreen"
    default n
    help
      Focaltech touch driver version 3.2 for the FT5X26 chipset.
      The FT5X26 series of chips are single chip capacitive touch panel
      controller, with built in MCU for fast response and high accuracy.
      Say Y here if you have Focaltech touch panel.
      If unsure, say N.

config TOUCHSCREEN_FTS_DIRECTORY
    string "Focaltech ts directory name"
    default "focaltech_touch"
    depends on TOUCHSCREEN_FTS_V32
```

## drivers/input/touchscreen/ilitek_251x/Kconfig
```kconfig
config TOUCHSCREEN_ILI251X
	tristate "Ilitek ILI251X  touchscreen"
	depends on I2C
	help
	  Say Y here if you have a ILI251X based touchscreen
	  controller.

	  If unsure, say N.

	  To compile this driver as a module, choose M here: the
	  module will be called ili2510.
```

## drivers/input/touchscreen/siw/Kconfig
```kconfig
menu "SiW Touch Support"

config TOUCHSCREEN_SIW
	bool "Silicon Works Touch Driver Core"
	depends on SPI_MASTER && I2C
	default n
	help
	  Say Y here if you have a touchscreen interface using
	  the Silicon Works touch device.

config TOUCHSCREEN_SIW_LG4894
	bool "Silicon Works Touch Driver for LG4894"
	depends on TOUCHSCREEN_SIW
	default n
	help
	  If your device is LG4894, say Y

config TOUCHSCREEN_SIW_LG4895
	bool "Silicon Works Touch Driver for LG4895"
	depends on TOUCHSCREEN_SIW
	default n
	help
	  If your device is LG4895, say Y

config TOUCHSCREEN_SIW_LG4946
	bool "Silicon Works Touch Driver for LG4946"
	depends on TOUCHSCREEN_SIW
	default n
	help
	  If your device is LG4946, say Y

config TOUCHSCREEN_SIW_LG4951
	bool "Silicon Works Touch Driver for LG4951"
	depends on TOUCHSCREEN_SIW
	default n
	help
	  If your device is LG4951, say Y

config TOUCHSCREEN_SIW_SW1828
	bool "Silicon Works Touch Driver for SW1828"
	depends on TOUCHSCREEN_SIW
	default n
	help
	  If your device is SW1828, say Y

config TOUCHSCREEN_SIW_SW49407
	bool "Silicon Works Touch Driver for SW49407"
	depends on TOUCHSCREEN_SIW
	default n
	help
	  If your device is SW49407, say Y

config TOUCHSCREEN_SIW_SW42101
	bool "Silicon Works Touch Driver for SW42101"
	depends on TOUCHSCREEN_SIW
	default n
	help
	  If your device is SW42101, say Y


source "drivers/input/touchscreen/siw/mon/Kconfig"

endmenu
```

## drivers/input/touchscreen/st/Kconfig
```kconfig
#
# STMicroelectronics touchscreen driver configuration
#

config TOUCHSCREEN_ST_I2C
	tristate "STMicroelectronics i2c touchscreen"
	depends on TOUCHSCREEN_ST
	help
	  This enables support for ST touch panel over I2C based touchscreens.

config TOUCHSCREEN_ST_DEBUG
	tristate "fts_proc and stm_fts_cmd enabled"
	depends on TOUCHSCREEN_ST
	default n
	help
	  This enables fts_proc and stm_fts_cmd features for debug support.
```

## drivers/mfd/adnc/Kconfig
```kconfig
#
# Multifunction miscellaneous devices
#

if HAS_IOMEM
menu "Knowles IAxxx Multifunction device drivers"

config MFD_IAXXX
	tristate "Knowles IAxxx Audio Device"
	select REGMAP
	select MFD_CORE
	help
	  This is the MFD core driver for the Knowles IAxxx device

endmenu
endif

if MFD_IAXXX
# IAxxx bus interfaces
config MFD_IAXXX_I2C
	bool "I2C bus-interface"
	select REGMAP_I2C
	depends on I2C
	---help---
	  Enable I2C Bus interface for IAXXX MFD driver

config MFD_IAXXX_SPI
	bool "SPI bus-interface"
	select REGMAP_SPI
	depends on SPI
	---help---
	  Enable SPI Bus interface for IAXXX MFD driver

config MFD_IAXXX_SOUNDWIRE
	bool "SoundWire bus-interface"
	select REGMAP_SWR
	select SOUNDWIRE_WCD_CTRL
	depends on SOUNDWIRE
	---help---
	  Enable SoundWire Bus interface for IAXXX MFD driver

config MFD_IAXXX_ATHENS_FPGA
        bool "Enable Athens FPGA changes"
        ---help---
        This config enables the changes required for FPGA.

config MFD_IAXXX_REGMAP_FPGA
        bool "Enable REGMAP FPGA changes"
        ---help---
        This config enables the changes required for FPGA.

config MFD_IAXXX_DEBUG_DUMP
	bool "Enable debug dump in tunnel driver"
	depends on DEBUG_FS
	---help---
	  Enable DEBUG Dump for IAXXX MFD tunnel driver
endif
```

## drivers/mfd/dbmdx/Kconfig
```kconfig
#
# Multifunction DBMDX configuration
#
config MFD_DBMDX
	tristate "DSPG MFD Core driver"
	depends on MFD_CORE
	help
	  Select this option to enable DSPG Voice Trigger/Enhancement Chip.

config DBMDX_MHA
	tristate "DBMDX MH Acoustics algorithm interface"
	depends on MFD_DBMDX
	select FB_MHA
	default n
	help
          Select this option to allow access ot mHA algorithm

config DBMDX_TILT
	bool "Tilt Angle"
	depends on MFD_DBMDX
	default n
	help
	  Select this option to enable tilt angle related features

config DBMDX_STAX
	tristate "DBMDX STAX algorithm interface"
	depends on MFD_DBMDX
	select DBMDX_CHAR_CORE
	default n
	help
	  Select this option to build stax algorithm

config DBMDX_STAX_DSPG
	bool "Dbmdx stax dspg"
	depends on MFD_DBMDX
	default n
	help
	  Select this option to allow access to stax algorithm

config DBMDX_TV_DETECT
	bool "DBMDX TV detect features enable"
	depends on MFD_DBMDX
	default n
	help
	  Select this option for TV detect features
```

## drivers/staging/facebook/Kconfig
```kconfig
config FB_DEFERRED_DRV
        tristate "Trigger deferred drivers"
        default y
        help
          Dummy driver for triggering all deferred drivers
```

## drivers/staging/myriad/Kconfig
```kconfig
menuconfig MYRIAD_FLASHER
	tristate "Myriad flash over SPI support"
	depends on SPI
	---help---
	  Myriad flash over SPI support
```

## drivers/usb/pd/Kconfig
```kconfig
#
# USB Power Delivery driver configuration
#
menu "USB Power Delivery"

config USB_PD
	def_bool n

config USB_PD_POLICY
	tristate "USB Power Delivery Protocol and Policy Engine"
	depends on EXTCON
	depends on DUAL_ROLE_USB_INTF
	select USB_PD
	help
          Say Y here to enable USB PD protocol and policy engine.

config QPNP_USB_PDPHY
	tristate "QPNP USB Power Delivery PHY"
	depends on SPMI
	help
          Say Y here to enable QPNP USB PD PHY peripheral driver
	  which communicates over the SPMI bus. The is used to handle
	  the PHY layer communication of the Power Delivery stack.

config USB_USE_USB2_DEVICE_WHEN_DP_CONNECTED
	bool "Enable USB2 Device When DP connected"
	depends on USB_PD
	default n
	help
	  When display port is connected the USB is configured as
	  host mode by default. Enable this option if USB device mode
	  is necessary while DP is connected.

endmenu
```

## sound/soc/codecs/adnc/Kconfig
```kconfig
#
# iaxxx codec driver
#
if MFD_IAXXX
config SND_SOC_IAXXX
	tristate "Knowles IAxxx Audio Device"
	---help---
	  Enable codec driver for IAxxx
config IAXXX_PCM_MODE
	bool "Enable PCM DAI"
	---help---
	This config enables IAXXX PCM

endif
```

## sound/soc/codecs/dbmdx/Kconfig
```kconfig
#
# SoC audio configuration
#

config SND_SOC_DBMDX
	tristate "DSPG Sound Codec"
	depends on MFD_DBMDX
	default n
	help
	  Select this option to enable the DSPG audio codec.
```
