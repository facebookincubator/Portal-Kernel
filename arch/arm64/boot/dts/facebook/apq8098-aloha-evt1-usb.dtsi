/* Copyright (c) 2017, Facebook Inc. All rights reserved.
 *
 * This program is free software; you can redistribute it and/or modify
 * it under the terms of the GNU General Public License version 2 and
 * only version 2 as published by the Free Software Foundation.
 *
 * This program is distributed in the hope that it will be useful,
 * but WITHOUT ANY WARRANTY; without even the implied warranty of
 * MERCHANTABILITY or FITNESS FOR A PARTICULAR PURPOSE.  See the
 * GNU General Public License for more details.
 */

&qusb_phy0 {
	reg = <0x0c012000 0x2a8>,
	      <0x01fcb24c 0x4>;
	reg-names = "qusb_phy_base",
			"tcsr_clamp_dig_n_1p8";
	qcom,qusb-phy-init-seq =
				/* <value reg_offset> */
				<0x80 0x0
				0x13 0x04
				0x7c 0x18c
				0x80 0x2c
				0x0a 0x184
				0xbb 0x23c /* tune1 */
				0x0e 0x240 /* tune2 */
				0x05 0x248 /* tune4 */
				0xd0 0x21c>; /* imp_ctrl1 */
};
