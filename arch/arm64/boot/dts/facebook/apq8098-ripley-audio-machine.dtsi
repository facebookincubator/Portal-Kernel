/* Copyright (c) 2018, Facebook Inc. All rights reserved.
 *
 * This program is free software; you can redistribute it and/or modify
 * it under the terms of the GNU General Public License version 2 and
 * only version 2 as published by the Free Software Foundation.
 *
 * This program is distributed in the hope that it will be useful,
 * but WITHOUT ANY WARRANTY; without even the implied warranty of
 * MERCHANTABILITY or FITNESS FOR A PARTICULAR PURPOSE.  See the
 * GNU General Public License for more details.
 */
#include <dt-bindings/gpio/gpio.h>

/* Machine driver definition */
/*
 * I2S1 <-> DSPG <-> AMP
 */
&snd_9335 {
	asoc-codec = <&stub_codec>, <&ext_disp_audio_codec>, <&dbmd7_spi>;
	asoc-codec-names = "msm-stub-codec.1", "msm-ext-disp-audio-codec-rx", "dbmdx";
	qcom,audio-routing = "OUTL", "AIF IN",
			"DBMDX TDM0 Playback", "Primary TDM0 Playback";
	/delete-property/ qcom,mi2s-audio-intf;
	dbmdx,tdm-pri;
	dbmdx,tdm-sec;
	tfa98xx,dbmdx-i2s;
};
