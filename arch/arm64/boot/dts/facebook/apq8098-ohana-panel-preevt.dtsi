/* Copyright (c) 2018, Facebook Inc. All rights reserved.
 *
 * This program is free software; you can redistribute it and/or modify
 * it under the terms of the GNU General Public License version 2 and
 * only version 2 as published by the Free Software Foundation.
 *
 * This program is distributed in the hope that it will be useful,
 * but WITHOUT ANY WARRANTY; without even the implied warranty of
 * MERCHANTABILITY or FITNESS FOR A PARTICULAR PURPOSE.  See the
 * GNU General Public License for more details.
 */

&dsi_tv101wxm_nl3_video {
		qcom,mdss-dsi-on-command = [
			39 01 00 00 00 00 05 FF AA 55 25 01
			15 01 00 00 01 00 02 FC 08
			15 01 00 00 00 00 02 FC 00
			39 01 00 00 14 00 05 FF AA 55 25 00
			39 01 00 00 00 00 06 F0 55 AA 52 08 00
			39 01 00 00 00 00 03 B1 68 01
			39 01 00 00 00 00 05 B8 01 02 02 02
			15 01 00 00 01 00 02 B6 11
			39 01 00 00 00 00 03 BB 63 63
			39 01 00 00 00 00 03 BC 00 00
			39 01 00 00 00 00 06 BD 02 BB 11 10 00
			15 01 00 00 01 00 02 C8 80
			39 01 00 00 00 00 06 F0 55 AA 52 08 01
			39 01 00 00 00 00 03 B3 28 28
			39 01 00 00 00 00 03 B4 14 14
			39 01 00 00 00 00 03 B9 44 44
			39 01 00 00 00 00 03 BA 24 24
			39 01 00 00 00 00 03 BC 78 00
			39 01 00 00 00 00 03 BD 78 00
			39 01 00 00 00 00 06 F0 55 AA 52 08 02
			15 01 00 00 00 00 02 EE 03
			39 01 00 00 00 00 11 B0 00 00 00 0F 00 48 00 5F 00 7F 00 A2 00 C1 00 F7
			39 01 00 00 00 00 11 B1 01 1D 01 5A 01 8C 01 D8 02 12 02 14 02 49 02 82
			39 01 00 00 00 00 11 B2 02 A7 02 DA 02 FB 03 2B 03 4A 03 72 03 8D 03 AD
			39 01 00 00 00 00 05 B3 03 D0 03 D3
			39 01 00 00 00 00 11 B4 00 C9 00 D0 00 DB 00 E7 00 F1 01 05 01 17 01 36
			39 01 00 00 00 00 11 B5 01 52 01 82 01 AA 01 EA 02 1F 02 21 02 53 02 8B
			39 01 00 00 00 00 11 B6 02 AE 02 DF 02 FF 03 30 03 4F 03 74 03 90 03 B0
			39 01 00 00 00 00 05 B7 03 D1 03 D3
			39 01 00 00 00 00 11 B8 01 1C 01 20 01 27 01 2E 01 34 01 42 01 4E 01 65
			39 01 00 00 00 00 11 B9 01 7A 01 A1 01 C2 01 F9 02 2A 02 2C 02 5C 02 93
			39 01 00 00 00 00 11 BA 02 B8 02 EB 03 0E 03 3E 03 56 03 7A 03 94 03 BE
			39 01 00 00 00 00 05 BB 03 D1 03 D3
			39 01 00 00 00 00 06 F0 55 AA 52 08 03
			39 01 00 00 00 00 03 B0 00 00
			39 01 00 00 00 00 03 B1 00 00
			39 01 00 00 00 00 06 B2 05 01 55 00 1A
			39 01 00 00 00 00 06 BA 53 01 55 00 3A
			15 01 00 00 00 00 02 C4 60
			15 01 00 00 00 00 02 C5 40
			39 01 00 00 00 00 06 F0 55 AA 52 08 04
			39 01 00 00 00 00 05 B1 03 02 05 07
			39 01 00 00 00 00 06 F0 55 AA 52 08 05
			39 01 00 00 00 00 06 BD 01 01 00 00 03
			15 01 00 00 00 00 02 C0 09
			39 01 00 00 00 00 03 C8 07 38
			39 01 00 00 00 00 06 D1 00 05 01 00 00
			15 01 00 00 00 00 02 E5 03
			15 01 00 00 00 00 02 E6 03
			15 01 00 00 00 00 02 E9 03
			15 01 00 00 00 00 02 EA 03
			39 01 00 00 00 00 06 F0 55 AA 52 08 06
			39 01 00 00 00 00 03 B0 2D 2D
			39 01 00 00 00 00 03 B1 01 01
			39 01 00 00 00 00 03 B2 34 34
			39 01 00 00 00 00 03 B3 2E 2E
			39 01 00 00 00 00 03 B4 2E 2D
			39 01 00 00 00 00 03 B5 2D 13
			39 01 00 00 00 00 03 B6 13 11
			39 01 00 00 00 00 03 B7 11 36
			39 01 00 00 00 00 03 B8 36 15
			39 01 00 00 00 00 03 B9 15 2E
			39 01 00 00 00 00 03 BA 2E 14
			39 01 00 00 00 00 03 BB 14 35
			39 01 00 00 00 00 03 BC 35 10
			39 01 00 00 00 00 03 BD 10 12
			39 01 00 00 00 00 03 BE 12 2D
			39 01 00 00 00 00 03 BF 2D 2E
			39 01 00 00 00 00 03 C0 2E 2E
			39 01 00 00 00 00 03 C1 34 34
			39 01 00 00 00 00 03 C2 00 00
			39 01 00 00 00 00 03 C3 2D 2D
			39 01 00 00 00 00 03 C4 2E 2E
			39 01 00 00 00 00 03 C5 00 00
			39 01 00 00 00 00 03 C6 34 34
			39 01 00 00 00 00 03 C7 2D 2D
			39 01 00 00 00 00 03 C8 2E 2D
			39 01 00 00 00 00 03 C9 2D 14
			39 01 00 00 00 00 03 CA 14 35
			39 01 00 00 00 00 03 CB 35 10
			39 01 00 00 00 00 03 CC 10 12
			39 01 00 00 00 00 03 CD 12 2E
			39 01 00 00 00 00 03 CE 2E 13
			39 01 00 00 00 00 03 CF 13 11
			39 01 00 00 00 00 03 D0 11 36
			39 01 00 00 00 00 03 D1 36 15
			39 01 00 00 00 00 03 D2 15 2D
			39 01 00 00 00 00 03 D3 2D 2E
			39 01 00 00 00 00 03 D4 2D 2D
			39 01 00 00 00 00 03 D5 34 34
			39 01 00 00 00 00 03 D6 01 01
			39 01 00 00 00 00 03 D7 2E 2E
			39 01 00 00 00 00 06 D8 00 00 00 00 00
			39 01 00 00 00 00 06 D9 00 00 00 00 00
			39 01 00 00 00 00 03 E5 34 34
			39 01 00 00 00 00 03 E6 34 34
			39 01 00 00 00 00 03 E8 34 34
			39 01 00 00 00 00 03 E9 34 34
			39 01 00 00 00 00 06 F0 55 AA 52 00 00
			15 01 00 00 01 00 02 35 00
			05 01 00 00 78 00 01 11 /* exit_sleep_mode */
			05 01 00 00 14 00 01 29 /* set_display_on */
		];
};
