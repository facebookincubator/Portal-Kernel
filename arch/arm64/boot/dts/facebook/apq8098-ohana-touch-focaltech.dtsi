/* Copyright (c) 2017, Facebook Inc. All rights reserved.
 *
 * This program is free software; you can redistribute it and/or modify
 * it under the terms of the GNU General Public License version 2 and
 * only version 2 as published by the Free Software Foundation.
 *
 * This program is distributed in the hope that it will be useful,
 * but WITHOUT ANY WARRANTY; without even the implied warranty of
 * MERCHANTABILITY or FITNESS FOR A PARTICULAR PURPOSE.  See the
 * GNU General Public License for more details.
 */
#include <dt-bindings/gpio/gpio.h>

&i2c_5 {
	focaltech@38{
		compatible = "focaltech,ft5x26";
		reg = <0x38>;
		interrupt-parent = <&tlmm>;
		interrupts = <125 IRQ_TYPE_EDGE_FALLING>;
		focaltech,reset-gpio = <&tlmm 89 GPIO_ACTIVE_LOW>;
		focaltech,irq-gpio = <&tlmm 125 IRQ_TYPE_EDGE_FALLING>;
		focaltech,max-touch-number = <5>;
		focaltech,display-coords =  <0 0 800 1280>;
		vdd-supply = <&pm8998_l28>;
		vcc_i2c-supply = <&pm8998_l6>;
		focaltech,touch-wakeup-on;
	};
};

