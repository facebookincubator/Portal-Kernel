/* Copyright (c) 2017, Facebook Inc. All rights reserved.
 *
 * This program is free software; you can redistribute it and/or modify
 * it under the terms of the GNU General Public License version 2 and
 * only version 2 as published by the Free Software Foundation.
 *
 * This program is distributed in the hope that it will be useful,
 * but WITHOUT ANY WARRANTY; without even the implied warranty of
 * MERCHANTABILITY or FITNESS FOR A PARTICULAR PURPOSE.  See the
 * GNU General Public License for more details.
 */
#include <dt-bindings/gpio/gpio.h>

&i2c_5 {
	st_fts@49{
		compatible = "st,fts";
		reg = <0x49>;
		interrupt-parent = <&tlmm>;
		interrupts = <125 IRQ_TYPE_EDGE_FALLING>;
		st,irq-gpio = <&tlmm 125 IRQ_TYPE_EDGE_FALLING>;
		st,reset-gpio = <&tlmm 89 GPIO_ACTIVE_LOW>;
		avdd-supply = <&pm8998_l28>;
		vdd-supply = <&pm8998_l6>;
                pinctrl-names = "pmx_ts_active", "pmx_ts_suspend";
                pinctrl-0 = <&ts_active>;
                pinctrl-1 = <&ts_int_suspend &ts_reset_suspend>;
		st,regulator_dvdd = "vdd";
		st,regulator_avdd = "avdd";
	};
};

