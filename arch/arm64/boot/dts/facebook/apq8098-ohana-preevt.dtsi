/* Copyright (c) 2018, Facebook Inc. All rights reserved.
 *
 * This program is free software; you can redistribute it and/or modify
 * it under the terms of the GNU General Public License version 2 and
 * only version 2 as published by the Free Software Foundation.
 *
 * This program is distributed in the hope that it will be useful,
 * but WITHOUT ANY WARRANTY; without even the implied warranty of
 * MERCHANTABILITY or FITNESS FOR A PARTICULAR PURPOSE.  See the
 * GNU General Public License for more details.
 */

#include "apq8098-ohana-proto.dtsi"
#include "apq8098-ohana-panel-enable-pwm.dtsi"
#include "apq8098-ohana-touch-st.dtsi"
#include "apq8098-ohana-preevt-usb.dtsi"
#include "apq8098-ohana-panel-preevt.dtsi"

&tas5760 {
	amp_sdz-gpios = <&tlmm 49 GPIO_ACTIVE_HIGH>;
};
