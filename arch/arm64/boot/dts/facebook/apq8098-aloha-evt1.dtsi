/* Copyright (c) 2017, Facebook Inc. All rights reserved.
 *
 * This program is free software; you can redistribute it and/or modify
 * it under the terms of the GNU General Public License version 2 and
 * only version 2 as published by the Free Software Foundation.
 *
 * This program is distributed in the hope that it will be useful,
 * but WITHOUT ANY WARRANTY; without even the implied warranty of
 * MERCHANTABILITY or FITNESS FOR A PARTICULAR PURPOSE.  See the
 * GNU General Public License for more details.
 */

#include "apq8098-aloha-common.dtsi"
#include "apq8098-aloha-blsp.dtsi"
#include "apq8098-aloha-panel.dtsi"
#include "apq8098-aloha-evt1-headless.dtsi"
#include "apq8098-aloha-evt1-camera-sensor.dtsi"
#include "apq8098-aloha-sensors.dtsi"
#include "apq8098-aloha-touch-melfas.dtsi"
#include "apq8098-aloha-audio-evt1.dtsi"
#include "apq8098-aloha-audio-cl35.dtsi"
#include "apq8098-aloha-audio-d4100.dtsi"
#include "apq8098-aloha-leds.dtsi"
#include "apq8098-aloha-temp.dtsi"
#include "apq8098-aloha-evt1-usb.dtsi"
