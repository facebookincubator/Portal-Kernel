/* Copyright (c) 2018, Facebook Inc. All rights reserved.
 *
 * This program is free software; you can redistribute it and/or modify
 * it under the terms of the GNU General Public License version 2 and
 * only version 2 as published by the Free Software Foundation.
 *
 * This program is distributed in the hope that it will be useful,
 * but WITHOUT ANY WARRANTY; without even the implied warranty of
 * MERCHANTABILITY or FITNESS FOR A PARTICULAR PURPOSE.  See the
 * GNU General Public License for more details.
 */
#include <dt-bindings/gpio/gpio.h>

/* Machine driver definition */
/*
 * I2S1 <-> DSPG
 * I2S4 <-> AMP
 */
&snd_9335 {
	qcom,model = "fb-ripleyp2-snd-card";
};

&tfa98xx {
	sample-rate = <48000>;
	bit-width = <32>;
	fw-name = "tfa98xx.cnt";
};

/* Disable QUAT MI2S */
&dbmd7_spi {
	pinctrl-names = "default";
	pinctrl-0 = <	&quat_aux_pcm_sleep
			&quat_mi2s_sd0_sleep
			&quat_aux_pcm_dout_sleep >;
};
