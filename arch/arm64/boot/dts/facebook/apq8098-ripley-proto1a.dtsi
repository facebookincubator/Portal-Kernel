/* Copyright (c) 2018, Facebook Inc. All rights reserved.
 *
 * This program is free software; you can redistribute it and/or modify
 * it under the terms of the GNU General Public License version 2 and
 * only version 2 as published by the Free Software Foundation.
 *
 * This program is distributed in the hope that it will be useful,
 * but WITHOUT ANY WARRANTY; without even the implied warranty of
 * MERCHANTABILITY or FITNESS FOR A PARTICULAR PURPOSE.  See the
 * GNU General Public License for more details.
 */

#include "apq8098-ripley-common.dtsi"
#include "apq8098-aloha-evt1-camera-sensor.dtsi"
#include "apq8098-ohana-proto-camera-sensor.dtsi"
#include "apq8098-ripley-blsp.dtsi"
#include "apq8098-ripley-audio.dtsi"
#include "apq8098-ripley-audio-tfa98xx.dtsi"
#include "apq8098-ripley-audio-dspg.dtsi"
#include "apq8098-ripley-audio-machine.dtsi"
#include "apq8098-ripley-audio-p1.dtsi"
#include "apq8098-ripley-proto-lp5569.dtsi"
#include "apq8098-ripley-proto-motor.dtsi"
#include "apq8098-ripley-proto-tcs3430.dtsi"
#include "apq8098-ripley-proto-sensors.dtsi"
#include "apq8098-ripley-proto-temp.dtsi"
