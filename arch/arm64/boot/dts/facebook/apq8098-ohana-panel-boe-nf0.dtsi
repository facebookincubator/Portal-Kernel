/* Copyright (c) 2018, The Linux Foundation. All rights reserved.
 *
 * This program is free software; you can redistribute it and/or modify
 * it under the terms of the GNU General Public License version 2 and
 * only version 2 as published by the Free Software Foundation.
 *
 * This program is distributed in the hope that it will be useful,
 * but WITHOUT ANY WARRANTY; without even the implied warranty of
 * MERCHANTABILITY or FITNESS FOR A PARTICULAR PURPOSE.  See the
 * GNU General Public License for more details.
 */

&mdss_mdp {
	dsi_tv101wxm_nf0_video: qcom,mdss_dsi_tv101wxm_nf0_video {
		qcom,mdss-dsi-panel-name =
				"BOE TV101WXM-NF0 WXGA video mode dsi panel";
		qcom,mdss-dsi-panel-type = "dsi_video_mode";
		qcom,mdss-dsi-panel-framerate = <60>;
		qcom,mdss-dsi-virtual-channel-id = <0>;
		qcom,mdss-dsi-stream = <0>;
		qcom,mdss-dsi-panel-width = <800>;
		qcom,mdss-dsi-panel-height = <1280>;
		qcom,mdss-dsi-h-front-porch = <180>;
		qcom,mdss-dsi-h-back-porch = <64>;
		qcom,mdss-dsi-h-pulse-width = <16>;
		qcom,mdss-dsi-h-sync-skew = <0>;
		qcom,mdss-dsi-v-back-porch = <8>;
		qcom,mdss-dsi-v-front-porch = <16>;
		qcom,mdss-dsi-v-pulse-width = <4>;
		qcom,mdss-dsi-bpp = <24>;
		qcom,mdss-dsi-mdp-trigger = "none";
		qcom,mdss-dsi-lp11-init;
		qcom,mdss-dsi-reset-sequence = <1 1>, <0 1>, <1 20>;
		qcom,mdss-dsi-always-on;
		qcom,mdss-dsi-bllp-eof-power-mode;
		qcom,mdss-dsi-bllp-power-mode;
		qcom,mdss-dsi-lane-0-state;
		qcom,mdss-dsi-lane-1-state;
		qcom,mdss-dsi-lane-2-state;
		qcom,mdss-dsi-lane-3-state;
		qcom,mdss-dsi-panel-timings =
			[00 13 04 04 1F 1E 05 05 03 03 04 00];
		qcom,mdss-dsi-t-clk-post = <0x0a>;
		qcom,mdss-dsi-t-clk-pre = <0x20>;
		qcom,mdss-pan-physical-width-dimension = <142>;
		qcom,mdss-pan-physical-height-dimension = <228>;
		qcom,mdss-dsi-mode-sel-gpio-state = "single_port";
		qcom,panel-supply-entries =
				<&dsi_panel_pwr_supply_no_labibb_BOE>;
		qcom,mdss-dsi-off-delay-send-rst-ms = <100>; /* BOE T10 spec */
		qcom,mdss-dsi-bl-pmic-control-type = "bl_ctrl_pwm";
		qcom,mdss-dsi-bl-min-level = <1>;
		qcom,mdss-dsi-bl-max-level = <255>;
		qcom,mdss-dsi-bl-pmic-pwm-frequency = <1000>;
		qcom,mdss-dsi-bl-pmic-bank-select = <0>;
		pwms = <&pmi8998_pwm_2 0 0>; /* BACKLIGHT_PWM */
		pwm-names = "backlight";
		qcom,mdss-dsi-on-command = [
			15 00 00 00 00 00 02 E0 00
			15 00 00 00 00 00 02 E1 93
			15 00 00 00 00 00 02 E2 65
			15 00 00 00 00 00 02 E3 F8
			15 00 00 00 00 00 02 80 03
			15 00 00 00 00 00 02 E0 01
			15 00 00 00 00 00 02 00 00
			15 00 00 00 00 00 02 01 6F
			15 00 00 00 00 00 02 17 00
			15 00 00 00 00 00 02 18 C0
			15 00 00 00 00 00 02 19 00
			15 00 00 00 00 00 02 1A 00
			15 00 00 00 00 00 02 1B C0
			15 00 00 00 00 00 02 1C 00
			15 00 00 00 00 00 02 1F 3E
			15 00 00 00 00 00 02 20 28
			15 00 00 00 00 00 02 21 28
			15 00 00 00 00 00 02 22 7E
			15 00 00 00 00 00 02 35 26
			15 00 00 00 00 00 02 37 09
			15 00 00 00 00 00 02 38 04
			15 00 00 00 00 00 02 39 00
			15 00 00 00 00 00 02 3A 01
			15 00 00 00 00 00 02 3C 7C
			15 00 00 00 00 00 02 3D FF
			15 00 00 00 00 00 02 3E FF
			15 00 00 00 00 00 02 3F 7F
			15 00 00 00 00 00 02 40 06
			15 00 00 00 00 00 02 41 A0
			15 00 00 00 00 00 02 42 81
			15 00 00 00 00 00 02 43 08
			15 00 00 00 00 00 02 44 0B
			15 00 00 00 00 00 02 45 28
			15 00 00 00 00 00 02 55 0F
			15 00 00 00 00 00 02 57 69
			15 00 00 00 00 00 02 59 0A
			15 00 00 00 00 00 02 5A 28
			15 00 00 00 00 00 02 5B 14
			15 00 00 00 00 00 02 5D 7F
			15 00 00 00 00 00 02 5E 5F
			15 00 00 00 00 00 02 5F 51
			15 00 00 00 00 00 02 60 44
			15 00 00 00 00 00 02 61 40
			15 00 00 00 00 00 02 62 31
			15 00 00 00 00 00 02 63 36
			15 00 00 00 00 00 02 64 21
			15 00 00 00 00 00 02 65 3A
			15 00 00 00 00 00 02 66 3A
			15 00 00 00 00 00 02 67 39
			15 00 00 00 00 00 02 68 58
			15 00 00 00 00 00 02 69 48
			15 00 00 00 00 00 02 6A 54
			15 00 00 00 00 00 02 6B 4A
			15 00 00 00 00 00 02 6C 48
			15 00 00 00 00 00 02 6D 38
			15 00 00 00 00 00 02 6E 26
			15 00 00 00 00 00 02 6F 12
			15 00 00 00 00 00 02 70 7F
			15 00 00 00 00 00 02 71 5F
			15 00 00 00 00 00 02 72 51
			15 00 00 00 00 00 02 73 44
			15 00 00 00 00 00 02 74 40
			15 00 00 00 00 00 02 75 31
			15 00 00 00 00 00 02 76 36
			15 00 00 00 00 00 02 77 21
			15 00 00 00 00 00 02 78 3A
			15 00 00 00 00 00 02 79 3A
			15 00 00 00 00 00 02 7A 39
			15 00 00 00 00 00 02 7B 58
			15 00 00 00 00 00 02 7C 48
			15 00 00 00 00 00 02 7D 54
			15 00 00 00 00 00 02 7E 4A
			15 00 00 00 00 00 02 7F 48
			15 00 00 00 00 00 02 80 38
			15 00 00 00 00 00 02 81 26
			15 00 00 00 00 00 02 82 12
			15 00 00 00 00 00 02 E0 02
			15 00 00 00 00 00 02 00 1E
			15 00 00 00 00 00 02 01 1E
			15 00 00 00 00 00 02 02 41
			15 00 00 00 00 00 02 03 41
			15 00 00 00 00 00 02 04 43
			15 00 00 00 00 00 02 05 43
			15 00 00 00 00 00 02 06 1F
			15 00 00 00 00 00 02 07 1F
			15 00 00 00 00 00 02 08 1F
			15 00 00 00 00 00 02 09 1F
			15 00 00 00 00 00 02 0A 1E
			15 00 00 00 00 00 02 0B 1E
			15 00 00 00 00 00 02 0C 1F
			15 00 00 00 00 00 02 0D 47
			15 00 00 00 00 00 02 0E 47
			15 00 00 00 00 00 02 0F 45
			15 00 00 00 00 00 02 10 45
			15 00 00 00 00 00 02 11 4B
			15 00 00 00 00 00 02 12 4B
			15 00 00 00 00 00 02 13 49
			15 00 00 00 00 00 02 14 49
			15 00 00 00 00 00 02 15 1F
			15 00 00 00 00 00 02 16 1E
			15 00 00 00 00 00 02 17 1E
			15 00 00 00 00 00 02 18 40
			15 00 00 00 00 00 02 19 40
			15 00 00 00 00 00 02 1A 42
			15 00 00 00 00 00 02 1B 42
			15 00 00 00 00 00 02 1C 1F
			15 00 00 00 00 00 02 1D 1F
			15 00 00 00 00 00 02 1E 1F
			15 00 00 00 00 00 02 1F 1F
			15 00 00 00 00 00 02 20 1E
			15 00 00 00 00 00 02 21 1E
			15 00 00 00 00 00 02 22 1F
			15 00 00 00 00 00 02 23 46
			15 00 00 00 00 00 02 24 46
			15 00 00 00 00 00 02 25 44
			15 00 00 00 00 00 02 26 44
			15 00 00 00 00 00 02 27 4A
			15 00 00 00 00 00 02 28 4A
			15 00 00 00 00 00 02 29 48
			15 00 00 00 00 00 02 2A 48
			15 00 00 00 00 00 02 2B 1F
			15 00 00 00 00 00 02 58 40
			15 00 00 00 00 00 02 5B 30
			15 00 00 00 00 00 02 5C 03
			15 00 00 00 00 00 02 5D 30
			15 00 00 00 00 00 02 5E 01
			15 00 00 00 00 00 02 5F 02
			15 00 00 00 00 00 02 63 14
			15 00 00 00 00 00 02 64 6A
			15 00 00 00 00 00 02 67 73
			15 00 00 00 00 00 02 68 05
			15 00 00 00 00 00 02 69 14
			15 00 00 00 00 00 02 6A 6A
			15 00 00 00 00 00 02 6B 08
			15 00 00 00 00 00 02 6C 00
			15 00 00 00 00 00 02 6D 00
			15 00 00 00 00 00 02 6E 00
			15 00 00 00 00 00 02 6F 88
			15 00 00 00 00 00 02 77 DD
			15 00 00 00 00 00 02 79 0E
			15 00 00 00 00 00 02 7A 03
			15 00 00 00 00 00 02 7D 14
			15 00 00 00 00 00 02 7E 6A
			15 00 00 00 00 00 02 E0 04
			15 00 00 00 00 00 02 09 11
			15 00 00 00 00 00 02 0E 48
			15 00 00 00 00 00 02 2B 2B
			15 00 00 00 00 00 02 2D 03
			15 00 00 00 00 00 02 2E 44
			15 00 00 00 00 00 02 E0 00
			15 00 00 00 00 00 02 E6 02
			15 00 00 00 00 00 02 E7 0C
			15 01 00 00 00 00 02 35 00
			05 01 00 00 78 00 01 11 /* exit_sleep_mode */
			05 01 00 00 0A 00 01 29 /* set_display_on */
		];
		qcom,mdss-dsi-off-command = [
			05 01 00 00 14 00 01 28
			05 01 00 00 50 00 01 10
		];
		qcom,mdss-dsi-on-command-state = "dsi_lp_mode";
		qcom,mdss-dsi-off-command-state = "dsi_lp_mode";
	};
};
