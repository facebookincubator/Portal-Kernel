## Documentation/devicetree/bindings/display/bridge/lt,lt8911exb.txt
```
LT8911EXB DSI to eDP bridge chip
--------------------------------

This is the drm driver for Lontium LT8911 bridge IC.

Required properties:
- compatible: "lt,lt8911exb"
- reg: i2c address of the chip, 0x29 as per datasheet
- reset-gpios: gpio specification for reset pin (active high)

- vdd-supply: Digital core 1.8V Power
- vcc-supply: 1.8V Power for other logics

Optional properties:
- connector-override: Override connector init, and attach to panel on init
- continuous-splash: If true, don't initialize major settings during
  power on to use the settings from bootloader

- clock-names: should be "refclk"
- clocks: Specification for input reference clock.
  The reference could be 25MHz.

Example
-------

lt8911exb: lt8911exb@29 {
	compatible = "lt,lt8911exb";
	#address-cells = <1>;
	#size-cells = <0>;
	reg = <0x29>;

	reset-gpios = <&tlmm 138 GPIO_ACTIVE_HIGH>;

	vdd-supply = <&lt8911exb_vdd_ldo>;
	vcc-supply = <&pm660_l12>;

	/* Use external refclock */
	clock-names = "refclk";
	clocks = <&bridge_refclock 0>;

	/* Override connector init, and attach to panel on init*/
	connector-override;

	/* Enable continuous splash */
	continuous-splash;

	ports {
		#address-cells = <1>;
		#size-cells = <0>;

		port@0 {
			reg = <0>;

			edp_bridge_in: endpoint {
				remote-endpoint = <&ext_dsi_out>;
			};
		};

		port@1 {
			reg = <1>;

			edp_bridge_out: endpoint {
				data-lanes = <0 1 2 3>;
				lane-polarities = <0 0 0 0>;
				remote-endpoint = <&edp_panel_in>;
			};
		};
	};
};
```

## Documentation/devicetree/bindings/display/panel/boe,tv140wtmnf0wu-plus.txt
```
BOE BOE-TV140WTM-NF0-WU-PLUS 2160x1440 14" EDP panel

Required properties:
- compatible: should be "boe,tv140wtmnf0wu-plus"

This binding is compatible with the simple-panel binding, which is specified
in simple-panel.txt in this directory.
```

## Documentation/devicetree/bindings/display/panel/innolux,zj140ia-01b.txt
```
Innolux ZJ140IA_01B 2160x1440 14" EDP panel

Required properties:
- compatible: should be "innolux,zj140ia-01b"

This binding is compatible with the simple-panel binding, which is specified
in simple-panel.txt in this directory.
```

## Documentation/devicetree/bindings/iio/accel/orient_gpio.txt
```
* IIO driver to control orientaion using gpio

Required properties:

  - compatible = "orient_gpio"
  - landscape = landscape GPIO pin
  - portrait = portrait GPIO pin

Optional properties:

  - default-orientation : 0 = landscape (default)
			  1 = portrait
			  2 = no default

Example:

orient_gpio {
	compatible = "orient_gpio";
	pinctrl-names = "default", "sleep";
	pinctrl-0 = <&orient_gpio_active>;
	pinctrl-1 = <&orient_gpio_suspend>;
	default-orientation = <1>;
	landscape = <&tlmm 81 GPIO_ACTIVE_LOW>;
	portrait = <&tlmm 82 GPIO_ACTIVE_LOW>;
};

&tlmm {
	orient_gpio_pinctrl {
		orient_gpio_active: orient_gpio_active {
			mux {
				pins = "gpio81", "gpio82";
				function = "gpio";
			};

			config {
				pins = "gpio81", "gpio82";
				drive-strength = <2>;   /* 2 mA */
				bias-disable;           /* NO PULL */
			};
		};

		orient_gpio_suspend: orient_gpio_suspend {
			mux {
				pins = "gpio81", "gpio82";
				function = "gpio";
			};

			config {
				pins = "gpio81", "gpio82";
				drive-strength = <2>;   /* 2 mA */
				bias-disable;           /* NO PULL */
			};
		};
	};
};
```

## Documentation/devicetree/bindings/iio/light/al3010.txt
```
* Dyna Image AL3010 I2C Ambient Light Sensor

Required properties:
- compatible: must be "al3010"
- reg: the I2C address of the device

Example:


	al3010@1E {
		compatible = "al3010";
		reg = <0x1E>;
		#io-channel-cells = <1>;
	};
```

## Documentation/devicetree/bindings/iio/light/tcs3430.txt
```
* AMS TCS3430 Color and Ambient Light Sensor

Required properties:
- compatible: must be "tcs3430"
- reg: the I2C address of the device

Example:


        tcs3430@0x39 {
                compatible = "tcs3430";
                reg = <0x39>;
        };
```

## Documentation/devicetree/bindings/input/melfas_mip4_ts.txt
```
* Melfas touch controller device tree bindings

melfas,mip4_ts is required.

Example:
	melfas_mip4_ts@48 {
		compatible = "melfas,mip4_ts";
		reg = <0x48>;
		interrupt-parent = <&msmgpio>;
		interrupts = <5 0x0>;
		vd33-supply = <&pm8941_l13>;
		pinctrl-names = "enable", "disable";
		pinctrl-0 = <&intr_on &ce_on>;
		pinctrl-1 = <&intr_off &ce_off>;
		irq-gpio = <&msmgpio 5 0x0>;
		ce-gpio = <&msmgpio 6 0x0>;
		vd33_en-gpio = <&msmgpio 7 0x0>;
	};
```

## Documentation/devicetree/bindings/input/touchscreen/ft5x26-ts.txt
```
FocalTech touch controller

Example:

	focaltech@38{
		compatible = "focaltech,fts";
		reg = <0x38>;
		interrupt-parent = <&tlmm>;
		interrupts = <125 IRQ_TYPE_EDGE_FALLING>;
		focaltech,reset-gpio = <&tlmm 89 GPIO_ACTIVE_LOW>;
		focaltech,irq-gpio = <&tlmm 125 IRQ_TYPE_EDGE_FALLING>;
		focaltech,max-touch-number = <5>;
		focaltech,display-coords =  <0 0 800 1280>;
		vdd-supply = <&pm8998_l28>;
		vcc_i2c-supply = <&pm8998_l6>;
	};
```

## Documentation/devicetree/bindings/leds/leds-aw9109.txt
```
* aw9109 led module

Required properties:
- compatible: must be "awinic,aw9109_led"
- reg: the I2C address of the device

Example:


	&i2c3 {
		aw9109_led@2c {
			compatible = "awinic,aw9109_led";
			reg = <0x2c>;
			reset-gpio = <&pio 63 0>;
			status = "okay";
			aw9109,led {
				aw9109,name = "aw9109_led";
				aw9109,imax = <1>;
				aw9109,brightness = <128>;
				aw9109,max_brightness = <255>;
			};
		};
	};
```

## Documentation/devicetree/bindings/media/i2c/tc358840.txt
```
* Toshiba TC358840 HDMI-RX to MIPI CSI2-TX Bridge

The Toshiba TC358840 HDMI-RX to MIPI CSI2-TX (H2C) is a bridge that converts
a HDMI stream to MIPI CSI-2 TX. It is programmable through I2C.

Required Properties:

- compatible: value should be "toshiba,tc358743"
- clocks, clock-names: should contain a phandle link to the reference clock
		       source, the clock input is named "refclk".

Optional Properties:

- reset-gpios: gpio phandle GPIO connected to the reset pin
- interrupts, interrupt-parent: GPIO connected to the interrupt pin
- data-lanes: should be <1 2 3 4> for four-lane operation,
	      or <1 2> for two-lane operation
- clock-lanes: should be <0>
- clock-noncontinuous: Presence of this boolean property decides whether the
		       MIPI CSI-2 clock is continuous or non-continuous.
- link-frequencies: List of allowed link frequencies in Hz. Each frequency is
		    expressed as a 64-bit big-endian integer. The frequency
		    is half of the bps per lane due to DDR transmission.

For further information on the MIPI CSI-2 endpoint node properties, see
Documentation/devicetree/bindings/media/video-interfaces.txt.

Example:

	tc358840xbg@0f {
		compatible = "toshiba,tc358840xbg";
		reg = <0x0f>;
		interrupt-parent = <&tlmm>;
		interrupts = <92 IRQ_TYPE_LEVEL_HIGH>;
		/* GPIO */
		reset-gpios = <&tlmm 91 GPIO_ACTIVE_HIGH>;
		refclk_hz = <48000000>; /* 40 - 50 MHz */

		clock-names = "tc358840xbg_clk";
		clocks = <&clock_rpmh AUDIO_AP_CLK2>;

		pinctrl-names = "active", "sleep";
		pinctrl-0 = <&tc358840xbg_irq_active &tc358840xbg_reset_active>;
		pinctrl-1 = <&tc358840xbg_irq_sleep &tc358840xbg_reset_sleep>;
		device-config = "config_C";
	};
```

## Documentation/devicetree/bindings/misc/led_control.txt
```
Binding for camera status leds
-------------------------------------------------------------------------
Misc device to control camera status leds from userspace through leds class interface.

Required properties:
- compatible : led_control

Each child has own label and id
- fb,label: Name of the led device.
- fb,led-id: ID of the led device.

Example:
led_control: led_control {
	compatible = "fb,led_control";

	cam_red: led0 {
		fb,label = "cam_red";
		fb,led-id = FB_LED_CTRL_RED;
	};

	cam_green: led1 {
		fb,label = "cam_green";
		fb,led-id = FB_LED_CTRL_GREEN;
	};

	cam_blue: led2 {
		fb,label = "cam_blue";
		fb,led-id = FB_LED_CTRL_BLUE;
	};
};
```

## Documentation/devicetree/bindings/misc/pd_camera.txt
```
Presence detection using camera
-------------------------------------------------------------------------
Driver that propagates presence detection events from camera to user space.

Required properties:
- compatible : pd_camera
- gpio-irq : GPIO that generates an interrupt when presence is detected.

Example:
	pd_camera: pd_camera {
		compatible = "pd_camera";
		gpio-irq = <&tlmm 28 1>;
	};
```

## Documentation/devicetree/bindings/platform/msm/msm_ar8151.txt
```
* Qualcomm Technologies, Inc. AR8151 driver module

This module enables the AR8151 pcie ep platform driver.

Required properties:
- compatible:		Must be "qcom,ar8151"
- qcom,pcie-parent	pcie-parent

Example:
	qcom,ar8151 {
		compatible = "qcom,ar8151";
		qcom,pcie-parent = <&pcie0>;
	}
```

## Documentation/devicetree/bindings/power/supply/bq40z50-fg.txt
```
TI BQ40Z50 Fuel-Gauge Power Supply bindings

Required properties:
- compatible: should be "ti,bq40z50"
- reg: i2c address of the device

Optional properties:
- ti,fg-soc-low-thr: low battery soc threshold, valid range: 1 ~ 10
- ti,fg-soc-recharge-thr: recharge soc threshold, valid range: 90 ~ 99
- ti,fg-soc-static-remap: if defined, soc will be remapped as below
  capacity reports 100 for soc range between ti,fg-soc-recharge-thr ~ 100
  capacity reports 1 for range between 1 ~ ti,fg-soc-low-thr
  capacity reports linear mapping from ti,fg-soc-low-thr+1 ~ ti,fg-soc-recharge-thr-1 to 2 ~ 99

Example:

bq40z50: bq40z50@b {
	compatible = "ti,bq40z50";
	reg = <0xb>;
	ti,fg-soc-low-thr = <3>;
	ti,fg-soc-recharge-thr = <95>;
	ti,fg-soc-static-remap;
};
```

## Documentation/devicetree/bindings/power/supply/fbfg_battery.txt
```
FB Fg Fuel-Gauge Power Supply bindings

Required properties:
- compatible: should be one of followings
	"fb,fbfg_sbs"
	"fb,fbfg_raj240045"
- reg: i2c address of the device

Optional properties:
- fb,init_max_retries: Maximum number to retry init.
- fb,i2c_retry_limit: Maximum number to retry i2c comm.
- fb,monitor_period_ms: Polling period to monitor fg status.
- fb,num_cells: Number of cells on battery.
- fb,fg-soc-low-thr: low battery soc threshold, valid range: 1 ~ 10
- fb,fg-soc-recharge-thr: recharge soc threshold, valid range: 90 ~ 99
- fb,fg-soc-static-remap: if defined, soc will be remapped as below
  capacity reports 100 for soc range between fb,fg-soc-recharge-thr ~ 100
  capacity reports 1 for range between 1 ~ fb,fg-soc-low-thr
  capacity reports linear mapping from fb,fg-soc-low-thr+1 ~ fb,fg-soc-recharge-thr-1 to 2 ~ 99

Example:

raj240045: raj240045@b {
	compatible = "fb,fbfg_raj240045";
	reg = <0xb>;
	fb,init_max_retries = <10>;
	fb,i2c_retry_limit = <10>;
	fb,monitor_period_ms = <60000>;
	fb,num_cells = <3>;
	fb,fg-soc-low-thr = <3>;
	fb,fg-soc-recharge-thr = <95>;
	fb,fg-soc-static-remap;
};
```

## Documentation/devicetree/bindings/power/supply/isl9538.txt
```
Binding for Renesas isl9538 Li-Ion Charger

Required properties:
- compatible: Should be "renesas,isl9538"
- reg: integer, i2c address of the device.
- isl,charge-current: integer, maximum charging current (in uA);
- isl,charge-voltage: integer, maximum charging voltage
- isl,adapter-current-limit-2: integer, charging current limit
- isl,adapter-current-limit-1: integer, charging current limit
- isl,trickle-charging-current:
	Usage: optional
	Type: <u32>
	Definition: Configures the charging current in trickle charging mode.
	OPTIONS:
	ISL_TRICKLE_CHARGE_CURR_256MA
	ISL_TRICKLE_CHARGE_CURR_128MA
	ISL_TRICKLE_CHARGE_CURR_64MA
	ISL_TRICKLE_CHARGE_CURR_512MA

- qcom,adapter-vadc :
	Usage: optional
	Type: phandl
	Definition: phaldle to the corresponding VADC device to read the ADC channels.
	This field and isl,channel-num are required to read adapter vadc.

- isl,channel-num
  Usage: optional
  Value type: <u32>
  Definition: Specifies the ADC channel number for reading adapter voltage. This field and
	qcom,adapter-vadc are required to read adapter vadc.

- isl,adapter-voltage-vadc-map:
  Usage: optional
  Type: Array of 2-tuple <u32> items. (<adapter_voltage_mv vadc_value-mv>;)
  Description: Each item consists of adapter voltage and min vadc value.
	The pair indicates expected minimum vadc value given the adapter voltage

- isl,interval-normal
  Usage: optional
  Default: 5 seconds
  Value type: <u32>
  Description: The interval of charging monitor in seconds in normal mode
        Normal mode means default mode except maintenance and low batt

- isl,interval-maintenance
  Usage: optional
  Default: 10 seconds
  Value type: <u32>
  Definition: The interval of charging monitor in seconds in maintenance mode
        Maintenance mode: no charging due to charging complete

- isl,interval-lowbatt
  Usage: optional
  Default: 1 seconds
  Value type: <u32>
  Definition: The interval of charging monitor in seconds in low battery mode
        Low battery mode is determined when the battery capacity is less than or equal to lowbatt-capacity

- isl,lowbatt-capacity
  Usage: optional
  Default: 1
  Value type: <u32>
  Definition: The battery capacity to use the charging monitor interval defined by isl,interval-lowbatt

Example:
	isl,adapter-voltage-vadc-map =
		< 20000 1338>,
		<     0    0>;

- isl,min-charge-adapter-voltage: Minimum adapter voltage in mV required for charger
	to start charging.
	isl,min-charge-adapter-voltage = <20000>;

isl9538: isl9538@9 {
	compatible = "renesas,isl9538";
	reg = <0x9>;
	isl,charge-voltage = <16768>; //4S battery
	isl,charge-current = <1000>;
	isl,adapter-current-limit-2 = <3800>;
	isl,adapter-current-limit-1 = <2368>;
	isl,trickle-charging-current = <ISL_TRICKLE_CHARGE_CURR_128MA>;
	acok-gpio = <&pm660_gpios 3 0>;
	interrupt-parent = <&spmi_bus>;
	pinctrl-names = "default";
	pinctrl-0 = <&charger_acok_default>;
};
```

## Documentation/devicetree/bindings/sound/fb,deferred_probe_trigger.txt
```
Bindings for fb,dummy_platform driver
------------------------------------------------------------

Dummy platform driver

Required property:
- compatible: fb,dummy_platform

Example:
	my_dummy: my_dummy {
		compatible = "fb,deferred_probe_trigger";
	};
```

## Documentation/devicetree/bindings/usb/ptn36502.txt
```
* NXP PTN36502 re-driver IC device tree bindings

Example:
       ptn36502@1a {
               compatible = "nxp,ptn36502";
               reg = <0x1a>;
       };
```

## drivers/char/dbmdx/Kconfig
```kconfig
#
# DBMDX character drivers configuration
#
config DBMDX_CHAR_CORE
	bool "DBMDX group of character drivers"
	depends on MFD_DBMDX
	default n
	help
	  Select this option to all group of DBMDX character drivers

config DBMDX_LOG
	tristate "DBMDX Log character driver"
	depends on DBMDX_CHAR_CORE
	default n
	help
	  Select this option to get the firmware logs of all the N cores through /dev/dbmdx-N.
```

## drivers/iio/accel/bma456/Kconfig
```kconfig
#
# Makefile for Bosch sensors driver.
#

config BMA4XY_ACCEL
	tristate "Bosch BMA456 Accelerometer Driver"
	select IIO_BUFFER
	select IIO_TRIGGERED_BUFFER
	select REGMAP
	select BMA4XY_ACCEL_SPI if SPI
	help
	 Say yes here to build support for the BMA456 Bosch accelerometer.

config BOSCH_DRIVER_LOG_FUNC
	tristate "Bosch Sensortec driver smart log function support"
	depends on (I2C || SPI_MASTER) && SYSFS
	help
	 Say yes here to enable smart log function in Bosch Sensortec driver.
```

## drivers/input/misc/bma456/Kconfig
```kconfig
#
# Makefile for Bosch sensors driver.
#
config SENSORS_BMA456
	tristate "Bosch bma456 driver"
	depends on (I2C || SPI_MASTER) && SYSFS
	help
	 If you say yes here, you get support for Bosch Sensortec's
	 acceleration sensors BMA456.
```
